## sdkconfig.defaults
```kconfig
# ESP32-C6 目标芯片配置
CONFIG_IDF_TARGET="esp32c6"

# 控制台配置：使用UART0作为主控制台（可靠的串口输出）
# ESP32-C6 UART0: GPIO8(RX), GPIO9(TX)
CONFIG_ESP_CONSOLE_UART_DEFAULT=y
CONFIG_ESP_CONSOLE_UART_NUM=0
CONFIG_ESP_CONSOLE_UART_TX_GPIO=9
CONFIG_ESP_CONSOLE_UART_RX_GPIO=8

# 同时启用USB Serial/JTAG（可选，用于调试）
CONFIG_USB_SERIAL_JTAG=y
CONFIG_ESP_PHY_ENABLE_USB=y

# WiFi 配置
CONFIG_ESP_WIFI_ENABLED=y
CONFIG_WPA_MBEDTLS_CRYPTO=y

# MQTT 配置
CONFIG_MQTT_PROTOCOL_311=y
CONFIG_MQTT_TRANSPORT_SSL=n
CONFIG_MQTT_TRANSPORT_WEBSOCKET=n

# NVS Flash 配置
CONFIG_NVS_FLASH_ENCRYPTION=n

# LEDC PWM 配置（ESP32-C6使用LEDC）
CONFIG_LEDC_SUPPORT_APB_CLOCK=y

# SmartConfig (AirKiss) 配置
CONFIG_ESP_SMARTCONFIG_ENABLE=y

# 日志级别
CONFIG_LOG_DEFAULT_LEVEL_INFO=y

# 分区表配置
CONFIG_PARTITION_TABLE_SINGLE_APP=y

# 编译器优化（暂时禁用以便调试）
# CONFIG_OPTIMIZATION_LEVEL_RELEASE=y
CONFIG_OPTIMIZATION_LEVEL_DEBUG=y
```
